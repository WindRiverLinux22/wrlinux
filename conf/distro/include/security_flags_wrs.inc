## conf/distro/include/security_flags_wrs.inc
```bitbake
# Base on oe-core security flags
include conf/distro/include/security_flags.inc

# To override for multilib, use SECURITY_CFLAGS:pn-<pkg>_pn-<mlib>-<pkg>.
# If just SECURITY_CFLAGS:pn-<pkg> is defined, it will be used for all
# multilib variants, too.

# Reason: The recipe vdso-test located in wrlinux which has assemble code
SECURITY_CFLAGS:pn-vdso-test = ""

# Reason:
# upstream meta-secure-core refuse to set var-SECURITY_STACK_PROTECTOR to
# LDFLAGS and upstream oe-core refuse to remove var-SECURITY_STACK_PROTECTOR
# from LDFLAGS
SECURITY_LDFLAGS:remove:pn-libsign = "-fstack-protector-strong"
SECURITY_LDFLAGS:remove:pn-cryptfs-tpm2 = "-fstack-protector-strong"
```

## conf/distro/include/wrlinux-packageconfigs.inc
```bitbake
# PACKAGECONFIG settings of recipes for WRLinux

# Workaround for nmap possibly requiring python-pygtk which is not available
PACKAGECONFIG:remove:pn-nmap = "zenmap"

# we usually use gnutls as the default PACKAGECONFIG of wpa-supplicant, but its sub-packege gnutls-openssl
# is GPLv3, so need this check to switch to openssl if GLPv3 is blacklisted.
PACKAGECONFIG:pn-wpa-supplicant ?= "${@bb.utils.contains('INCOMPATIBLE_LICENSE', 'GPLv3', 'openssl', 'gnutls', d)}"

PACKAGECONFIG:pn-sysstat ?= "${@bb.utils.filter('DISTRO_FEATURES', 'systemd', d)} lm-sensors cron"

PACKAGECONFIG:append:pn-mesa-demos = "${@bb.utils.contains('DISTRO_FEATURES', 'weston-demo', ' wayland ', ' ', d)}"
```

## wrlinux-distro/conf/distro/include/wrlinux-bsp-qemuarm64.inc
```bitbake
MULTILIBS ?= "multilib:lib32"
DEFAULTTUNE:virtclass-multilib-lib32 ?= "armv7vethf"
```

## wrlinux-distro/conf/distro/include/wrlinux-bsp-qemux86-64.inc
```bitbake
MULTILIBS ?= "multilib:lib32" 
DEFAULTTUNE:virtclass-multilib-lib32 ?= "core2-32"
```

## wrlinux-distro/conf/distro/include/wrlinux-installer-recipelists.inc
```bitbake
RECIPE_LIST_LAYERS:remove = "meta-anaconda"

# Recipes allowed for meta-openembedded/meta-gnome
WRL_RECIPES:gnome-layer += "\
    keybinder \
    libgnomekbd \
    libnma \
    libtimezonemap \
    libuser \
    metacity \
    network-manager-applet \
    usermode \
    libgtop \
"

# Recipes allowed for meta-openembedded/meta-python
WRL_RECIPES:meta-python += "\
    python3-blivet \
    python3-blivetgui \
    python3-coverage \
    python3-langtable \
    python3-meh \
    python3-ntplib \
    python3-ordered-set \
    python3-pid \
    python3-prctl \
    python3-pydbus \
    python3-pykickstart \
    python3-pyparted \
    python3-pytz \
    python3-pyudev \
    python3-requests-file \
    python3-requests-ftp \
    python3-setuptools-scm \
    python3-systemd \
    python3-wrapt \
"

# Recipes allowed for meta-openembedded/meta-filesystems
WRL_RECIPES:filesystems-layer += "\
    ntfs-3g-ntfsprogs \
    xfsprogs \
"

# Recipes allowed for meta-openembedded/meta-oe
WRL_RECIPES:openembedded-layer += "\
    augeas \
    libinih \
    libpwquality \
    libreport \
    libtar \
    fltk \
    glade \
    gnome-doc-utils-stub \
    gnulib \
    isomd5sum \
    pps-tools \
    satyr \
    tigervnc \
    uthash \
    xmlrpc-c \
"

# Recipes allowed for meta-openembedded/meta-networking
WRL_RECIPES:networking-layer += "\
    chrony \
"
```

## wrlinux-distro/conf/distro/include/wrlinux-installer-whitelist.inc
```bitbake
PNWHITELIST_LAYERS:remove = "meta-anaconda"

# Whitelist for meta-openembedded/meta-gnome
PNWHITELIST:gnome-layer += "\
    keybinder \
    libgnomekbd \
    libnma \
    libtimezonemap \
    libuser \
    metacity \
    network-manager-applet \
    usermode \
    libgtop \
"

# Whitelist for meta-openembedded/meta-python
PNWHITELIST:meta-python += "\
    python3-blivet \
    python3-blivetgui \
    python3-coverage \
    python3-langtable \
    python3-meh \
    python3-ntplib \
    python3-ordered-set \
    python3-pid \
    python3-prctl \
    python3-pydbus \
    python3-pykickstart \
    python3-pyparted \
    python3-pytz \
    python3-pyudev \
    python3-requests-file \
    python3-requests-ftp \
    python3-setuptools-scm \
    python3-systemd \
    python3-wrapt \
"

# Whitelist for meta-openembedded/meta-filesystems
PNWHITELIST:filesystems-layer += "\
    ntfs-3g-ntfsprogs \
    xfsprogs \
"

# Whitelist for meta-openembedded/meta-oe
PNWHITELIST:openembedded-layer += "\
    augeas \
    libinih \
    libpwquality \
    libreport \
    libtar \
    fltk \
    glade \
    gnome-doc-utils-stub \
    gnulib \
    isomd5sum \
    pps-tools \
    satyr \
    tigervnc \
    uthash \
    xmlrpc-c \
"

# Whitelist for meta-openembedded/meta-networking
PNWHITELIST:networking-layer += "\
    chrony \
"
```

## wrlinux-ovp/conf/distro/include/wrlinux-ovp-recipelists.conf
```bitbake
#
# Copyright (C) 2017 Wind River Systems, Inc.
#
# Explicitly allow these recipes in wrlinux
#

# Recipes allowed the whole wrlinux-distro layer
RECIPE_LIST_LAYERS:remove = "wrlinux-ovp"

# Recipes allowed for meta-cloud-services
WRL_RECIPES:cloud-services-layer:append = " \
    celt051 \
    glusterfs \
    librdmacm \
"

# Recipes allowed for meta-openembedded/meta-filesystems
WRL_RECIPES:filesystems-layer:append = " \
    aufs-util \
    xfsdump \
    xfsprogs \
"

WRL_RECIPES:dpdk:append = " \
    dpdk \
"

WRL_RECIPES:meta-python:append = " \
    python3-appdirs \
    python3-automat \
    python3-click \
    python3-constantly \
    python3-hyperlink \
    python3-incremental \
    python3-pyserial \
    python3-twisted \
    python3-pyhamcrest \
    python3-bcrypt \
    python3-zopeinterface \
    python3-prettytable \
"

WRL_RECIPES:networking-layer:append = " \
    bridge-utils \
    ebtables \
    netcf \
    tunctl \
    spice \
    spice-protocol \
"

# Recipes allowed for meta-openembedded/meta-oe
WRL_RECIPES:openembedded-layer:append = " \
    augeas \
    byacc \
    gd \
    gnulib \
    hwloc \
    leveldb \
    libinih \
    lua \
    protobuf \
    protobuf-c \
    rabbitmq-c \
    rocksdb \
    gflags \
    yajl \
    libnet \
    snappy \
    zabbix \
    openldap \
"

# Recipes allowed for meta-realtime
WRL_RECIPES:realtime:append = " \
    schedtool-dl \
"

# Recipes allowed for meta-virtualization
WRL_RECIPES:virtualization-layer:append = " \
    ceph \
    cgroup-lite \
    compose-file \
    containerd-opencontainers \
    criu \
    diod \
    docker \
    docker-distribution \
    tini \
    go-systemd \
    go-capability \
    grpc-go \
    go-logrus \
    go-pty \
    go-mux \
    go-distribution \
    go-patricia \
    go-fsnotify \
    go-dbus \
    go-context \
    go-cli \
    go-connections \
    libibverbs \
    libvirt \
    libvmi \
    lxc \
    nagios-core \
    nagios-nrpe \
    nagios-nsca \
    nagios-plugins \
    notary \
    oath \
    openvswitch \
    runc-docker \
"

# Recipes allowed for meta-webserver
WRL_RECIPES:webserver:append = " \
    fcgi \
"
```

## wrlinux-ovp/conf/distro/include/wrlinux-ovp-whitelist.conf
```bitbake
#
# Copyright (C) 2017 Wind River Systems, Inc.
#
# Explicitly allow these recipes in wrlinux
#

# Whitelist the whole wrlinux-distro layer
PNWHITELIST_LAYERS:remove = "wrlinux-ovp"

# Whitelist for meta-cloud-services
PNWHITELIST:cloud-services-layer:append = " \
    celt051 \
    glusterfs \
    librdmacm \
"

# Whitelist for meta-openembedded/meta-filesystems
PNWHITELIST:filesystems-layer:append = " \
    aufs-util \
    xfsdump \
    xfsprogs \
"

PNWHITELIST:dpdk:append = " \
    dpdk \
"

PNWHITELIST:meta-python:append = " \
    python3-appdirs \
    python3-automat \
    python3-click \
    python3-constantly \
    python3-hyperlink \
    python3-incremental \
    python3-pyserial \
    python3-twisted \
    python3-pyhamcrest \
    python3-bcrypt \
    python3-zopeinterface \
    python3-prettytable \
"

PNWHITELIST:networking-layer:append = " \
    bridge-utils \
    ebtables \
    netcf \
    tunctl \
    spice \
    spice-protocol \
"

# Whitelist for meta-openembedded/meta-oe
PNWHITELIST:openembedded-layer:append = " \
    augeas \
    byacc \
    gd \
    gnulib \
    hwloc \
    leveldb \
    libinih \
    lua \
    protobuf \
    protobuf-c \
    rabbitmq-c \
    rocksdb \
    gflags \
    yajl \
    libnet \
    snappy \
    zabbix \
    openldap \
"

# Whitelist for meta-realtime
PNWHITELIST:realtime:append = " \
    schedtool-dl \
"

# Whitelist for meta-virtualization
PNWHITELIST:virtualization-layer:append = " \
    ceph \
    cgroup-lite \
    compose-file \
    containerd-opencontainers \
    criu \
    diod \
    docker \
    docker-distribution \
    tini \
    go-systemd \
    go-capability \
    grpc-go \
    go-logrus \
    go-pty \
    go-mux \
    go-distribution \
    go-patricia \
    go-fsnotify \
    go-dbus \
    go-context \
    go-cli \
    go-connections \
    libibverbs \
    libvirt \
    libvmi \
    lxc \
    nagios-core \
    nagios-nrpe \
    nagios-nsca \
    nagios-plugins \
    notary \
    oath \
    openvswitch \
    runc-docker \
"

# Whitelist for meta-webserver
PNWHITELIST:webserver:append = " \
    fcgi \
"
```

## wrlinux-ovp/conf/distro/wrlinux-ovp.conf
```bitbake
# Set this before including wrlinux.conf just in case that
# also tries to set it.
#

#@TYPE: Distro
#@NAME: Wind River Linux OVP
#@DESCRIPTION: Wind River Linux (Open Virtualization)

PREFERRED_PROVIDER_virtual/kernel = "linux-yocto-rt"

require conf/distro/wrlinux.conf
require conf/distro/include/wrlinux-ovp-recipelists.conf

# Note that layer.conf will only add items to BBFILES for
# the wrlinux-ovp distro (this one).
#
WRLINUX_VARIANT = " OVP"

# OVP distro should not be built for non-x86 archs
INHERIT += "compatible-archs"

# Set preferred providers
PREFERRED_PROVIDER_virtual/monitoring ?= "${@bb.utils.contains('MONITORING_FEATURES', 'zabbix', 'packagegroup-zabbix-monitoring',\
    bb.utils.contains('MONITORING_FEATURES', 'nagios', 'packagegroup-nagios-monitoring', 'packagegroup-empty-monitoring', d),d)}"

PREFERRED_PROVIDER_virtual/libibverbs ?= "libibverbs"

# By default including ovp layer will build Nagios core
MONITORING_FEATURES ?= "nagios core"

DISTRO_FEATURES:append = " virtualization kvm"
NON_MULTILIB_RECIPES:append = " ceph docker"

# The latest dpdk version compatible with the latest openvswitch version
PREFERRED_VERSION_dpdk ?= "21.11.%"
PREFERRED_VERSION_dpdk-module ?= "21.11.%"
```
